## kernel/linux-3.10.y/drivers/usb/ndis_driver/Kconfig
```kconfig
menu "NDIS_DRIVER support"

	config NDIS_DRIVER

	tristate "NDIS_DRIVER support"

	---help---

	NDIS_DRIVER use gpio as ir input .

	If you want NDIS_DRIVER support, you should say Y here and also to the

	specific driver for your bus adapter(s) below.

	This NDIS_DRIVER support can be built as a module.

endmenu
```

## scripts/kconfig/Kconfig.acc
```kconfig
#+++++++++++++++++++++++++++++++++++++++++++++++++++
#--------------------------------
config HI_ACC_SUPPORT
	bool "ACC Monitor Support"
	default y 
	help
	  If you want to compile acc_main, Say Y here.
```

## scripts/kconfig/Kconfig.gps
```kconfig
#+++++++++++++++++++++++++++++++++++++++++++++++++++
#--------------------------------
config HI_GPS_SUPPORT
	bool "GPS Support"
	default y 
	help
	  If you want to analyse gps, Say Y here.
```

## scripts/kconfig/Kconfig.led
```kconfig
#+++++++++++++++++++++++++++++++++++++++++++++++++++
#--------------------------------
config HI_LED_SUPPORT
	bool "LED Control Support"
	default y 
	help
	  If you want to compile led_main, Say Y here.
```
